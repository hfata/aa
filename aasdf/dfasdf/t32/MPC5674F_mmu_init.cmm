; rev 0.0 - b05111
; This script initializes the MPC5674F MMU the same as the BAM
; + EBI Physical Base Address changed to 0x2000_0000
; + VLE on flash, SRAM, and EBI

; Setup MMU for for Peripheral Bridge B and BAM
; Base address = 0xFFF0_0000
; 1MByte Memory Space, Guarded, Don't Cache, All Access
MMU.TLB1.SET 0. 0xC0000500 0xFFF0000A 0xFFF0003F

; Set up MMU for Internal Flash
; Base address = 0x0000_0000
; 16MByte Memory Space, Not Guarded, Don't Cache, All Access, VLE
MMU.TLB1.SET 1. 0xC0000700 0x00000028 0x0000003F

; Set up MMU for External Bus Interface
; Base address = 0x2000_0000
; 16MByte Memory Space, Not Guarded, Cachable, All Access, VLE
MMU.TLB1.SET 2. 0xC0000700 0x20000020 0x2000003F

; Set up MMU for Internal SRAM
; Base address = 0x4000_0000
; 256 KByte Memory Space, Not Guarded, Don't Cache, All Access, VLE
MMU.TLB1.SET 3. 0xC0000400 0x4000002A 0x4000003F

; Set up MMU for Peripheral Bridge A
; Base address = 0xC3F0_0000
; 1 MByte Memory Space, Not Guarded, Don't Cache, All Access
MMU.TLB1.SET 4. 0xC0000500 0xC3F00008 0xC3F0003F 

 



